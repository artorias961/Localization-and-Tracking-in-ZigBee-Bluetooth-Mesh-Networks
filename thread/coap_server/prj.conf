## prj.conf
```kconfig
#
# Copyright (c) 2020 Nordic Semiconductor
#
# SPDX-License-Identifier: LicenseRef-Nordic-5-Clause
#

# nRF board library
CONFIG_DK_LIBRARY=y

# Enable OpenThread CoAP support API
CONFIG_OPENTHREAD_COAP=y

# CONFIG_COAP_SERVER_LOG_LEVEL_INF=y

# Network shell
CONFIG_SHELL=y
CONFIG_OPENTHREAD_SHELL=y
CONFIG_SHELL_ARGC_MAX=26
CONFIG_SHELL_CMD_BUFF_SIZE=416

# Network sockets
CONFIG_NET_SOCKETS=y
CONFIG_NET_SOCKETS_POSIX_NAMES=y
CONFIG_NET_SOCKETS_POLL_MAX=4

# Same network Master Key for client and server
CONFIG_OPENTHREAD_NETWORKKEY="00:11:22:33:44:55:66:77:88:99:aa:bb:cc:dd:ee:ff"

# L2 OpenThread enabling
CONFIG_NET_L2_OPENTHREAD=y

# Generic networking options
CONFIG_NETWORKING=y

CONFIG_MBEDTLS_SHA1_C=n
CONFIG_FPU=y
```

## src/coap_server.c
```c
/*
 * Copyright (c) 2020 Nordic Semiconductor ASA
 *
 * SPDX-License-Identifier: LicenseRef-Nordic-5-Clause
 */

#include <zephyr/kernel.h>
#include <dk_buttons_and_leds.h>
#include <zephyr/logging/log.h>
#include <zephyr/net/openthread.h>
#include <openthread/thread.h>
#include <openthread/link.h>
#include <openthread/instance.h>
#include <openthread/coap.h>

#include "ot_coap_utils.h"

LOG_MODULE_REGISTER(coap_server, CONFIG_COAP_SERVER_LOG_LEVEL);

#define OT_CONNECTION_LED DK_LED1
#define PROVISIONING_LED DK_LED3
#define LIGHT_LED DK_LED4

#define COAP_SERVER_WORKQ_STACK_SIZE 512
#define COAP_SERVER_WORKQ_PRIORITY 5





K_THREAD_STACK_DEFINE(coap_server_workq_stack_area, COAP_SERVER_WORKQ_STACK_SIZE);
static struct k_work_q coap_server_workq;

static struct k_work provisioning_work;

static struct k_timer led_timer;
static struct k_timer provisioning_timer;


static void on_light_request(uint8_t command)
{
	static uint8_t val;

	switch (command) {
	case THREAD_COAP_UTILS_LIGHT_CMD_ON:
		dk_set_led_on(LIGHT_LED);
		val = 1;
		break;

	case THREAD_COAP_UTILS_LIGHT_CMD_OFF:
		dk_set_led_off(LIGHT_LED);
		val = 0;
		break;

	case THREAD_COAP_UTILS_LIGHT_CMD_TOGGLE:
		val = !val;
		dk_set_led(LIGHT_LED, val);
		break;

	default:
		break;
	}
	// calling the rssi
	get_and_print_rssi();
}

static void activate_provisioning(struct k_work *item)
{
	ARG_UNUSED(item);

	ot_coap_activate_provisioning();

	k_timer_start(&led_timer, K_MSEC(100), K_MSEC(100));
	k_timer_start(&provisioning_timer, K_SECONDS(5), K_NO_WAIT);

	LOG_INF("Provisioning activated");
}

static void deactivate_provisionig(void)
{
	k_timer_stop(&led_timer);
	k_timer_stop(&provisioning_timer);

	if (ot_coap_is_provisioning_active()) {
		ot_coap_deactivate_provisioning();
		LOG_INF("Provisioning deactivated");
	}
}

static void on_provisioning_timer_expiry(struct k_timer *timer_id)
{
	ARG_UNUSED(timer_id);

	deactivate_provisionig();
}

static void on_led_timer_expiry(struct k_timer *timer_id)
{
	static uint8_t val = 1;

	ARG_UNUSED(timer_id);

	dk_set_led(PROVISIONING_LED, val);
	val = !val;
}

static void on_led_timer_stop(struct k_timer *timer_id)
{
	ARG_UNUSED(timer_id);

	dk_set_led_off(PROVISIONING_LED);
}

static void on_button_changed(uint32_t button_state, uint32_t has_changed)
{
	uint32_t buttons = button_state & has_changed;

	if (buttons & DK_BTN4_MSK) {
		k_work_submit_to_queue(&coap_server_workq, &provisioning_work);
	}
}

static void on_thread_state_changed(otChangedFlags flags, struct openthread_context *ot_context,
				    void *user_data)
{
	if (flags & OT_CHANGED_THREAD_ROLE) {
		switch (otThreadGetDeviceRole(ot_context->instance)) {
		case OT_DEVICE_ROLE_CHILD:
		case OT_DEVICE_ROLE_ROUTER:
		case OT_DEVICE_ROLE_LEADER:
			dk_set_led_on(OT_CONNECTION_LED);
			break;

		case OT_DEVICE_ROLE_DISABLED:
		case OT_DEVICE_ROLE_DETACHED:
		default:
			dk_set_led_off(OT_CONNECTION_LED);
			deactivate_provisionig();
			break;
		}
	}
}
static struct openthread_state_changed_cb ot_state_chaged_cb = { .state_changed_cb =
									 on_thread_state_changed };


// void get_and_print_rssi(void){
// 	otInstance *instance = openthread_get_default_instance();
// 	int8_t rssi;
// 	int8_t avg_rssi;
// 	otError error;

// 	instance = otInstanceInitSingle();
// 	if(instance == NULL){
// 		LOG_ERR("Failed to get OpenThread instance");
// 		return 0;
// 	}
// 	// rssi = otThreadGetParentLastRssi(instance);
// 	// avg_rssi = otThreadGetParentAverageRssi();
// 	// LOG_WRN("Parent Last RSSI: %d dBm\n", rssi);

// 	error = otThreadGetParentLastRssi(instance, &rssi);
//     if (error == OT_ERROR_NONE) {
//         LOG_INF("Parent Last RSSI: %d dBm", rssi);
//     } else {
//         LOG_ERR("Failed to get RSSI: %d", error);
//     }

// }

// void get_and_print_rssi(void)
// {
//     otInstance *instance = openthread_get_default_instance();
//     int8_t rssi;
//     otError error;

//     if (instance == NULL) {
//         LOG_ERR("Failed to get OpenThread instance");
//         return;
//     }

//     error = otThreadGetParentLastRssi(instance, &rssi);
//     if (error == OT_ERROR_NONE) {
//         LOG_INF("Parent Last RSSI: %d dBm", rssi);
//     } else {
//         LOG_ERR("Failed to get RSSI: %d", error);
//     }
// }


// void broadcasting_rssi(void){
// 	otInstance *instance = openthread_get_default_instance();
    
   
// }

// static void handle_rssi_request(void *aContext, otMessage *aMessage, const otMessageInfo *aMessageInfo)
// {
//     otInstance *instance = (otInstance *)aContext;
//     int8_t rssi = otPlatRadioGetRssi(instance);

//     otCoapMessage responseMessage;
//     otMessageInfo responseInfo;

//     otCoapMessageInitResponse(&responseMessage, aMessage, OT_COAP_TYPE_ACKNOWLEDGMENT, OT_COAP_CODE_CONTENT);
//     otCoapMessageSetPayloadMarker(&responseMessage);

//     otMessageAppend(&responseMessage, &rssi, sizeof(rssi));

//     memcpy(&responseInfo, aMessageInfo, sizeof(responseInfo));

//     otCoapSendResponse(instance, &responseMessage, &responseInfo);
// }

// void init_coap_server(otInstance *instance)
// {
//     otCoapResource rssiResource = {
//         .mUriPath = "rssi",
//         .mHandler = &handle_rssi_request,
//         .mContext = instance,
//         .mNext = NULL
//     };

//     otCoapAddResource(instance, &rssiResource);
// }

int main(void)
{
	int ret;


	LOG_INF("Start CoAP-server sample");


	k_timer_init(&led_timer, on_led_timer_expiry, on_led_timer_stop);
	k_timer_init(&provisioning_timer, on_provisioning_timer_expiry, NULL);

	k_work_queue_init(&coap_server_workq);
	k_work_queue_start(&coap_server_workq, coap_server_workq_stack_area,
					K_THREAD_STACK_SIZEOF(coap_server_workq_stack_area),
					COAP_SERVER_WORKQ_PRIORITY, NULL);
	k_work_init(&provisioning_work, activate_provisioning);

	ret = ot_coap_init(&deactivate_provisionig, &on_light_request);
	if (ret) {
		LOG_ERR("Could not initialize OpenThread CoAP");
		goto end;
	}

	ret = dk_leds_init();
	if (ret) {
		LOG_ERR("Could not initialize leds, err code: %d", ret);
		goto end;
	}

	ret = dk_buttons_init(on_button_changed);
	if (ret) {
		LOG_ERR("Cannot init buttons (error: %d)", ret);
		goto end;
	}

	openthread_state_changed_cb_register(openthread_get_default_context(), &ot_state_chaged_cb);
	openthread_start(openthread_get_default_context());


end:
	return 0;
}
```
