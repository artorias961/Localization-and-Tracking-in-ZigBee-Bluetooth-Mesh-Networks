## thread/coap_client/build/Kconfig/Kconfig.shield
```kconfig
osource "c:/users/artorias961/desktop/notas/project/thesis/thread/coap_client/boards/shields/*/Kconfig.shield"
osource "C:/ncs/v2.6.1/nrf/boards/shields/*/Kconfig.shield"
```

## thread/coap_client/build/Kconfig/Kconfig.shield.defconfig
```kconfig
osource "c:/users/artorias961/desktop/notas/project/thesis/thread/coap_client/boards/shields/*/Kconfig.defconfig"
osource "C:/ncs/v2.6.1/nrf/boards/shields/*/Kconfig.defconfig"
```

## thread/coap_server/build/Kconfig/Kconfig.shield
```kconfig
osource "c:/users/artorias961/desktop/notas/project/thesis/thread/coap_server/boards/shields/*/Kconfig.shield"
osource "C:/ncs/v2.6.1/nrf/boards/shields/*/Kconfig.shield"
```

## thread/coap_server/build/Kconfig/Kconfig.shield.defconfig
```kconfig
osource "c:/users/artorias961/desktop/notas/project/thesis/thread/coap_server/boards/shields/*/Kconfig.defconfig"
osource "C:/ncs/v2.6.1/nrf/boards/shields/*/Kconfig.defconfig"
```

## trash/clean_container/build_child/Kconfig/Kconfig.shield
```kconfig
osource "c:/users/artorias961/desktop/notas/project/thesis/clean_container/boards/shields/*/Kconfig.shield"
osource "C:/ncs/v2.5.2/nrf/boards/shields/*/Kconfig.shield"
```

## trash/main/build/Kconfig/Kconfig.shield.defconfig
```kconfig
osource "c:/users/artorias961/desktop/notas/project/thesis/main/boards/shields/*/Kconfig.defconfig"
osource "C:/ncs/v2.6.1/nrf/boards/shields/*/Kconfig.defconfig"
```

## trash/nrf_container/build/Kconfig/Kconfig.shield.defconfig
```kconfig
osource "c:/users/artorias961/desktop/notas/project/thesis/nrf_container/boards/shields/*/Kconfig.defconfig"
osource "C:/ncs/v2.5.2/nrf/boards/shields/*/Kconfig.defconfig"
```

## trash/router/build/Kconfig/Kconfig.shield
```kconfig
osource "c:/users/artorias961/desktop/notas/project/thesis/router/boards/shields/*/Kconfig.shield"
osource "C:/ncs/v2.6.1/nrf/boards/shields/*/Kconfig.shield"
```

## trash/router/build/Kconfig/Kconfig.shield.defconfig
```kconfig
osource "c:/users/artorias961/desktop/notas/project/thesis/router/boards/shields/*/Kconfig.defconfig"
osource "C:/ncs/v2.6.1/nrf/boards/shields/*/Kconfig.defconfig"
```

## trash/router_3/build/Kconfig/Kconfig.shield.defconfig
```kconfig
osource "c:/users/artorias961/desktop/notas/project/thesis/router_3/boards/shields/*/Kconfig.defconfig"
osource "C:/ncs/v2.6.1/nrf/boards/shields/*/Kconfig.defconfig"
```

## zigbee/light_switch/build/Kconfig/Kconfig.shield.defconfig
```kconfig
osource "c:/users/artorias961/desktop/notas/project/thesis/zigbee/light_switch/boards/shields/*/Kconfig.defconfig"
osource "C:/ncs/v2.5.2/nrf/boards/shields/*/Kconfig.defconfig"
```
