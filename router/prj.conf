## prj.conf
```kconfig
#
# Copyright (c) 2020 Nordic Semiconductor ASA
#
# SPDX-License-Identifier: LicenseRef-Nordic-5-Clause
#

CONFIG_NCS_SAMPLES_DEFAULTS=y

CONFIG_UART_INTERRUPT_DRIVEN=y
CONFIG_SERIAL=y
CONFIG_GPIO=y
CONFIG_PWM=y

# Make sure printk is not printing to the UART console
CONFIG_CONSOLE=y
CONFIG_UART_CONSOLE=y

CONFIG_HEAP_MEM_POOL_SIZE=2048
CONFIG_MAIN_THREAD_PRIORITY=7

CONFIG_ZIGBEE=y
CONFIG_ZIGBEE_APP_UTILS=y
CONFIG_ZIGBEE_ROLE_ROUTER=y

# Enable DK LED and Buttons library
CONFIG_DK_LIBRARY=y

# This example requires more workqueue stack
CONFIG_SYSTEM_WORKQUEUE_STACK_SIZE=2048

# Enable nRF ECB driver
CONFIG_CRYPTO=y
CONFIG_CRYPTO_NRF_ECB=y
CONFIG_CRYPTO_INIT_PRIORITY=80

# Networking
CONFIG_NET_IPV6=n
CONFIG_NET_IP_ADDR_CHECK=n
CONFIG_NET_UDP=n

# Scene extension
CONFIG_ZIGBEE_SCENES=y




########################
### MY MODIFICATIONS ###
########################

# BLE configurations 
CONFIG_BT=y                         # Enable BLE support
CONFIG_BT_PERIPHERAL=y              # Enable BLE peripheral role
CONFIG_BT_CENTRAL=y                 # Enable BLE central role if needed

# RSSI Related (https://infocenter.nordicsemi.com/index.jsp?topic=%2Fsdk_tz_v4.2.0%2Fgroup__nrf__802154__rssi.html) (https://infocenter.nordicsemi.com/index.jsp?topic=%2Fug_sniffer_802154%2FUG%2Fsniffer_802154%2Fintro_802154.html)
CONFIG_NRF_802154_RADIO_DRIVER=y # To use the Radio RSSI library (basically meant for HAL)
```

## src/main.c
```c
/*
 * Copyright (c) 2020 Nordic Semiconductor ASA
 *
 * SPDX-License-Identifier: LicenseRef-Nordic-5-Clause
 */

/** @file
 *
 * @brief Simple Zigbee light bulb implementation.
 */

#include <zephyr/types.h>
#include <zephyr/kernel.h>
#include <zephyr/device.h>
#include <soc.h>
#include <zephyr/drivers/pwm.h>
#include <zephyr/logging/log.h>
#include <dk_buttons_and_leds.h>
#include <zephyr/settings/settings.h>

#include <zboss_api.h>
#include <zboss_api_addons.h>
#include <zb_mem_config_med.h>
#include <zigbee/zigbee_app_utils.h>
#include <zigbee/zigbee_error_handler.h>
#include <zigbee/zigbee_zcl_scenes.h>
#include <zb_nrf_platform.h>
#include "zb_dimmable_light.h"



#include <zb_zcl_common.h>
#include <zboss_api_zcl.h>
#include <zephyr/net/ieee802154_radio.h>
#include <zephyr/net/net_mgmt.h>
#include "zb_custom_cluster.h"
#include "zephyr/sys/util_internal.h" // A warning prompt this

LOG_MODULE_REGISTER(app, LOG_LEVEL_INF);

#define RUN_STATUS_LED                  DK_LED1
#define RUN_LED_BLINK_INTERVAL          1000

/* Device endpoint, used to receive light controlling commands. */
#define DIMMABLE_LIGHT_ENDPOINT         10

/* Version of the application software (1 byte). */
#define BULB_INIT_BASIC_APP_VERSION     01

/* Version of the implementation of the Zigbee stack (1 byte). */
#define BULB_INIT_BASIC_STACK_VERSION   10

/* Version of the hardware of the device (1 byte). */
#define BULB_INIT_BASIC_HW_VERSION      11

/* Manufacturer name (32 bytes). */
#define BULB_INIT_BASIC_MANUF_NAME      "Nordic"

/* Model number assigned by manufacturer (32-bytes long string). */
#define BULB_INIT_BASIC_MODEL_ID        "Dimable_Light_v0.1"

/* First 8 bytes specify the date of manufacturer of the device
 * in ISO 8601 format (YYYYMMDD). The rest (8 bytes) are manufacturer specific.
 */
#define BULB_INIT_BASIC_DATE_CODE       "20200329"

/* Type of power sources available for the device.
 * For possible values see section 3.2.2.2.8 of ZCL specification.
 */
#define BULB_INIT_BASIC_POWER_SOURCE    ZB_ZCL_BASIC_POWER_SOURCE_DC_SOURCE

/* Describes the physical location of the device (16 bytes).
 * May be modified during commissioning process.
 */
#define BULB_INIT_BASIC_LOCATION_DESC   "Office desk"

/* Describes the type of physical environment.
 * For possible values see section 3.2.2.2.10 of ZCL specification.
 */
#define BULB_INIT_BASIC_PH_ENV          ZB_ZCL_BASIC_ENV_UNSPECIFIED

/* LED indicating that light switch successfully joind Zigbee network. */
#define ZIGBEE_NETWORK_STATE_LED        DK_LED3

/* LED immitaing dimmable light bulb - define for informational
 * purposes only.
 */
#define BULB_LED                        DK_LED4

/* Button used to enter the Bulb into the Identify mode. */
#define IDENTIFY_MODE_BUTTON            DK_BTN4_MSK

/* Use onboard led4 to act as a light bulb.
 * The app.overlay file has this at node label "pwm_led3" in /pwmleds.
 */
#define PWM_DK_LED4_NODE                DT_NODELABEL(pwm_led3)

#if DT_NODE_HAS_STATUS(PWM_DK_LED4_NODE, okay)
static const struct pwm_dt_spec led_pwm = PWM_DT_SPEC_GET(PWM_DK_LED4_NODE);
#else
#error "Choose supported PWM driver"
#endif

/* Led PWM period, calculated for 100 Hz signal - in microseconds. */
#define LED_PWM_PERIOD_US               (USEC_PER_SEC / 100U)

#ifndef ZB_ROUTER_ROLE
#error Define ZB_ROUTER_ROLE to compile router source code.
#endif

/* Button to start Factory Reset */
#define FACTORY_RESET_BUTTON IDENTIFY_MODE_BUTTON




/* Main application customizable context.
 * Stores all settings and static values.
 */
typedef struct {
	zb_zcl_basic_attrs_ext_t basic_attr;
	zb_zcl_identify_attrs_t identify_attr;
	zb_zcl_scenes_attrs_t scenes_attr;
	zb_zcl_groups_attrs_t groups_attr;
	zb_zcl_on_off_attrs_t on_off_attr;
	zb_zcl_level_control_attrs_t level_control_attr;
} bulb_device_ctx_t;

/* Zigbee device application context storage. */
static bulb_device_ctx_t dev_ctx;

ZB_ZCL_DECLARE_IDENTIFY_ATTRIB_LIST(
	identify_attr_list,
	&dev_ctx.identify_attr.identify_time);

ZB_ZCL_DECLARE_GROUPS_ATTRIB_LIST(
	groups_attr_list,
	&dev_ctx.groups_attr.name_support);

ZB_ZCL_DECLARE_SCENES_ATTRIB_LIST(
	scenes_attr_list,
	&dev_ctx.scenes_attr.scene_count,
	&dev_ctx.scenes_attr.current_scene,
	&dev_ctx.scenes_attr.current_group,
	&dev_ctx.scenes_attr.scene_valid,
	&dev_ctx.scenes_attr.name_support);

ZB_ZCL_DECLARE_BASIC_ATTRIB_LIST_EXT(
	basic_attr_list,
	&dev_ctx.basic_attr.zcl_version,
	&dev_ctx.basic_attr.app_version,
	&dev_ctx.basic_attr.stack_version,
	&dev_ctx.basic_attr.hw_version,
	dev_ctx.basic_attr.mf_name,
	dev_ctx.basic_attr.model_id,
	dev_ctx.basic_attr.date_code,
	&dev_ctx.basic_attr.power_source,
	dev_ctx.basic_attr.location_id,
	&dev_ctx.basic_attr.ph_env,
	dev_ctx.basic_attr.sw_ver);

/* On/Off cluster attributes additions data */
ZB_ZCL_DECLARE_ON_OFF_ATTRIB_LIST(
	on_off_attr_list,
	&dev_ctx.on_off_attr.on_off);

ZB_ZCL_DECLARE_LEVEL_CONTROL_ATTRIB_LIST(
	level_control_attr_list,
	&dev_ctx.level_control_attr.current_level,
	&dev_ctx.level_control_attr.remaining_time);

ZB_DECLARE_DIMMABLE_LIGHT_CLUSTER_LIST(
	dimmable_light_clusters,
	basic_attr_list,
	identify_attr_list,
	groups_attr_list,
	scenes_attr_list,
	on_off_attr_list,
	level_control_attr_list);


ZB_DECLARE_DIMMABLE_LIGHT_EP(
	dimmable_light_ep,
	DIMMABLE_LIGHT_ENDPOINT,
	dimmable_light_clusters);

ZBOSS_DECLARE_DEVICE_CTX_1_EP(
	dimmable_light_ctx,
	dimmable_light_ep);










// <-------------------------------------------------------------- My Stuff (START)
// // Defining the RSSI values
// typedef struct{
// 	zb_int8_t rssi_value;
// } rssi_report_attrs_t;

// Defining the RSSI attributes
typedef struct {
    zb_int8_t rssi_value;
} rssi_report_attrs_t;

static rssi_report_attrs_t rssi_report_attrs = {
    .rssi_value = 0
};

static void energy_detection_callback(const struct device *dev, int8_t rssi, int status);
static void promiscuous_mode_callback(const struct device *dev, struct net_pkt *pkt);
static void start_energy_detection(struct net_if *iface);
static void start_promiscuous_mode(struct net_if *iface);
static void scan_for_device_and_report(void);
static void send_rssi_value(zb_int8_t rssi_value);
static void rssi_measurement_handler(zb_bufid_t bufid);
int8_t nrf_802154_rssi_last_get(void);
// net_mgmt_NET_REQUEST_IEEE802154_ED_SCAN(struct net_if *iface, struct ieee802154_req_params *params, size_t len);
// net_mgmt_NET_REQUEST_IEEE802154_SET_PROMISCUOUS_MODE(struct net_if *iface, bool *enable, size_t len);


zb_ret_t zb_zcl_finish_and_send_packet(zb_bufid_t buffer, zb_uint8_t *ptr, const zb_addr_u *dst_addr, zb_uint8_t dst_addr_mode, zb_uint8_t dst_ep, zb_uint16_t prof_id, zb_uint16_t cluster_id, zb_callback_t callback);



struct ieee802154_req_params {
    uint8_t channel;
    uint8_t duration;
};



// Declare attribute list and cluster list
ZB_ZCL_DECLARE_RSSI_REPORT_ATTRIB_LIST(rssi_report_attr_list, &rssi_report_attrs.rssi_value);
ZB_ZCL_DECLARE_RSSI_REPORT_CLUSTER_LIST(rssi_report_cluster_list, rssi_report_attr_list);

// Declare the endpoint
ZB_DECLARE_RSSI_REPORT_EP(rssi_report_ep, RSSI_REPORT_ENDPOINT, rssi_report_cluster_list);

// Declare device context
ZBOSS_DECLARE_DEVICE_CTX_1_EP(rssi_report_ctx, rssi_report_ep);



static void rssi_measurement_handler(zb_bufid_t bufid) {
    // Creating a variable to store the RSSI
	int8_t rssi;
	
	// Getting the last RSSI measurement (assuming the conversion is setup and since the attenna is bi directional, we can get negative values else we need a conditional statement)
	rssi = nrf_802154_rssi_last_get();
    LOG_INF("RSSI: %d dBm", rssi);

	// Send RSSI value to the coordinator 
	send_rssi_value(rssi);

    // Schedule next RSSI measurement
    ZB_SCHEDULE_APP_ALARM(rssi_measurement_handler, bufid, ZB_TIME_ONE_SECOND);
}



static void send_rssi_value(zb_int8_t rssi_value){
	// Creating a buffer variable
	zb_bufid_t bufid;
	zb_uint8_t *ptr;

	
	// Allocate OUT buffer size
	bufid = zb_buf_get_out();
	if(bufid){
		// Initialize buffer and returns pointer begining of the array (Zigbee Cluster Library - ZCL)
		ptr = ZB_ZCL_START_PACKET(bufid);

		// A macro to frame control field for specific command response basically a waiting time for each ptr [can be different]
		ZB_ZCL_CONSTRUCT_SPECIFIC_COMMAND_RESP_FRAME_CONTROL(ptr);

		// Settuping up the ZCL correctly (allocate buffer, a macro generates a sequence number to match the response, identifier for the Write Attributes Response)
		ZB_ZCL_CONTRUCT_COMMAND_HEADER(ptr, ZB_ZCL_GET_SEQ_NUM(), ZB_ZCL_CMD_WRITE_ATTRIB_RESP);

		/* The payload with the RSSI attributes infromation */
		// Put an 8-bit data value into a buffer (allocate buffer, last RSSI ID signal strength)
		ZB_ZCL_PACKET_PUT_DATA8(ptr, ZB_ZCL_ATTR_DIAGNOSTICS_LAST_RSSI_ID);

		// Put an 8-bit data value into a buffer (allocate buffer, ensures a 8 bit signed integer [since RSSI values are expressed in negative dBm])
		ZB_ZCL_PACKET_PUT_DATA8(ptr, ZB_ZCL_ATTR_TYPE_S8);

		// Put an 8-bit data value into a buffer (allocate buffer, actual RSSI)
		ZB_ZCL_PACKET_PUT_DATA8(ptr, rssi_value);

		// Finish ZCL and send packet (buffer, RSSI, Zigbee Cluster Command, 16 bit short address of the target device)                NOTES: https://community.home-assistant.io/t/zigbee-cluster-commands-broadcast/293700
		zb_zcl_finish_and_send_packet(bufid, ptr, 0xFFFF, ZB_APS_ADDR_MODE_16_ENDP_PRESENT, RSSI_REPORT_ENDPOINT, ZB_AF_HA_PROFILE_ID, ZB_ZCL_CLUSTER_ID_RSSI_REPORT, NULL);
	}
	else{
		LOG_ERR("Failed to allocate buffer for RSSI report");
	}

}


static void scan_for_device_and_report(void)
{
    // Determine which scanning detection we are going to use 
    bool use_energy_detection = true;
    bool use_promiscuous_mode = false;

    struct net_if *iface = net_if_get_default(); // Get the default network interface
    if (!iface) {
        LOG_ERR("Failed to get default network interface");
        return;
    }

    // If USE_ENERGY_DETECTION is set to TRUE, then use this scanning method
    if (use_energy_detection) {
        // Start energy detection scanning
        start_energy_detection(iface);
    }

    // If USE_PROMISCUOUS_MODE is set to TRUE, then use this scanning method
    if (use_promiscuous_mode) {
        // Start promiscuous mode scanning
        start_promiscuous_mode(iface);
    }

    // If both scanning methods are set to True or False then stop
    if ((use_energy_detection && use_promiscuous_mode) || (!use_energy_detection && !use_promiscuous_mode)) {
        LOG_ERR("Check scanning method boolean statement, either both set to FALSE or TRUE");
    }
}


static void start_energy_detection(struct net_if *iface)
{
    // Define the parameters for the energy detection scan
    struct ieee802154_req_params ed_params = {
        .channel = 26, // BIT(15),  // Example channel, adjust as needed
        .duration =   10 // 100,  // Duration in milliseconds
    };

    // Start the energy detection scan
    int result = net_mgmt(NET_REQUEST_IEEE802154_ED_SCAN, iface, &ed_params, sizeof(ed_params));
    
    // Check the result of the energy detection scan request
    if (result == 0) {
        printk("Energy detection scan started.\n");
    } else {
        printk("Failed to start energy detection scan (error %d).\n", result);
    }
}

static void energy_detection_callback(const struct device *dev, int8_t rssi, int status)
{
    if (status == 0) {
        printk("Energy detection result: %d dBm\n", rssi);
    } else {
        printk("Energy detection failed (status %d)\n", status);
    }
}





// static void start_promiscuous_mode(struct net_if *iface)
// {
//     // Enable promiscuous mode
//     bool enable = true;
    
//     // Request to set promiscuous mode
//     int result = net_mgmt(NET_REQUEST_IEEE802154_SET_PROMISCUOUS_MODE, iface, &enable, sizeof(enable));
    
//     // Check the result of the promiscuous mode request
//     if (result == 0) {
//         printk("Promiscuous mode enabled.\n");
//     } else {
//         printk("Failed to enable promiscuous mode (error %d).\n", result);
//     }
// }

// static void promiscuous_mode_callback(const struct device *dev, struct net_pkt *pkt)
// {
//     int8_t rssi = net_pkt_ieee802154_rssi(pkt);
//     printk("Promiscuous mode packet detected with RSSI: %d dBm\n", rssi);
//     net_pkt_unref(pkt); // Free the packet memory
// }



// <-------------------------------------------------------------- My Stuff (END)











/**@brief Starts identifying the device.
 *
 * @param  bufid  Unused parameter, required by ZBOSS scheduler API.
 */
static void start_identifying(zb_bufid_t bufid)
{
	ZVUNUSED(bufid);

	if (ZB_JOINED()) {
		/* Check if endpoint is in identifying mode,
		 * if not, put desired endpoint in identifying mode.
		 */
		if (dev_ctx.identify_attr.identify_time ==
		    ZB_ZCL_IDENTIFY_IDENTIFY_TIME_DEFAULT_VALUE) {

			zb_ret_t zb_err_code = zb_bdb_finding_binding_target(
				DIMMABLE_LIGHT_ENDPOINT);

			if (zb_err_code == RET_OK) {
				LOG_INF("Enter identify mode");
			} else if (zb_err_code == RET_INVALID_STATE) {
				LOG_WRN("RET_INVALID_STATE - Cannot enter identify mode");
			} else {
				ZB_ERROR_CHECK(zb_err_code);
			}
		} else {
			LOG_INF("Cancel identify mode");
			zb_bdb_finding_binding_target_cancel();
		}
	} else {
		LOG_WRN("Device not in a network - cannot enter identify mode");
	}
}

/**@brief Callback for button events.
 *
 * @param[in]   button_state  Bitmask containing the state of the buttons.
 * @param[in]   has_changed   Bitmask containing buttons that have changed their state.
 */
static void button_changed(uint32_t button_state, uint32_t has_changed)
{
	if (IDENTIFY_MODE_BUTTON & has_changed) {
		if (IDENTIFY_MODE_BUTTON & button_state) {
			/* Button changed its state to pressed */
		} else {
			/* Button changed its state to released */
			if (was_factory_reset_done()) {
				/* The long press was for Factory Reset */
				LOG_DBG("After Factory Reset - ignore button release");
			} else   {
				/* Button released before Factory Reset */

				/* Start identification mode */
				ZB_SCHEDULE_APP_CALLBACK(start_identifying, 0);
			}
		}
	}

	check_factory_reset_button(button_state, has_changed);
}

/**@brief Function for initializing additional PWM leds. */
static void pwm_led_init(void)
{
	if (!device_is_ready(led_pwm.dev)) {
		LOG_ERR("Error: PWM device %s is not ready",
			led_pwm.dev->name);
	}
}

/**@brief Function for initializing LEDs and Buttons. */
static void configure_gpio(void)
{
	int err;

	err = dk_buttons_init(button_changed);
	if (err) {
		LOG_ERR("Cannot init buttons (err: %d)", err);
	}

	err = dk_leds_init();
	if (err) {
		LOG_ERR("Cannot init LEDs (err: %d)", err);
	}

	pwm_led_init();
}

/**@brief Sets brightness of bulb luminous executive element
 *
 * @param[in] brightness_level Brightness level, allowed values 0 ... 255,
 *                             0 - turn off, 255 - full brightness.
 */
static void light_bulb_set_brightness(zb_uint8_t brightness_level)
{
	uint32_t pulse = brightness_level * LED_PWM_PERIOD_US / 255U;

	if (pwm_set_dt(&led_pwm, PWM_USEC(LED_PWM_PERIOD_US), PWM_USEC(pulse))) {
		LOG_ERR("Pwm led 4 set fails:\n");
		return;
	}
}

/**@brief Function for setting the light bulb brightness.
 *
 * @param[in] new_level   Light bulb brightness value.
 */
static void level_control_set_value(zb_uint16_t new_level)
{
	LOG_INF("Set level value: %i", new_level);

	ZB_ZCL_SET_ATTRIBUTE(
		DIMMABLE_LIGHT_ENDPOINT,
		ZB_ZCL_CLUSTER_ID_LEVEL_CONTROL,
		ZB_ZCL_CLUSTER_SERVER_ROLE,
		ZB_ZCL_ATTR_LEVEL_CONTROL_CURRENT_LEVEL_ID,
		(zb_uint8_t *)&new_level,
		ZB_FALSE);

	light_bulb_set_brightness(new_level);
}

/**@brief Function for turning ON/OFF the light bulb.
 *
 * @param[in]   on   Boolean light bulb state.
 */
static void on_off_set_value(zb_bool_t on)
{
	LOG_INF("Set ON/OFF value: %i", on);

	ZB_ZCL_SET_ATTRIBUTE(
		DIMMABLE_LIGHT_ENDPOINT,
		ZB_ZCL_CLUSTER_ID_ON_OFF,
		ZB_ZCL_CLUSTER_SERVER_ROLE,
		ZB_ZCL_ATTR_ON_OFF_ON_OFF_ID,
		(zb_uint8_t *)&on,
		ZB_FALSE);

	if (on) {
		light_bulb_set_brightness(dev_ctx.level_control_attr.current_level);
	} else {
		light_bulb_set_brightness(0U);
	}
}

/**@brief Function to toggle the identify LED - BULB_LED is used for this.
 *
 * @param  bufid  Unused parameter, required by ZBOSS scheduler API.
 */
static void toggle_identify_led(zb_bufid_t bufid)
{
	static int blink_status;

	light_bulb_set_brightness(((++blink_status) % 2) ? (255U) : (0U));
	ZB_SCHEDULE_APP_ALARM(toggle_identify_led, bufid, ZB_MILLISECONDS_TO_BEACON_INTERVAL(100));
}

/**@brief Function to handle identify notification events on the first endpoint.
 *
 * @param  bufid  Unused parameter, required by ZBOSS scheduler API.
 */
static void identify_cb(zb_bufid_t bufid)
{
	zb_ret_t zb_err_code;

	if (bufid) {
		/* Schedule a self-scheduling function that will toggle the LED. */
		ZB_SCHEDULE_APP_CALLBACK(toggle_identify_led, bufid);
	} else {
		/* Cancel the toggling function alarm and restore current Zigbee LED state. */
		zb_err_code = ZB_SCHEDULE_APP_ALARM_CANCEL(toggle_identify_led, ZB_ALARM_ANY_PARAM);
		ZVUNUSED(zb_err_code);

		if (dev_ctx.on_off_attr.on_off) {
			light_bulb_set_brightness(dev_ctx.level_control_attr.current_level);
		} else {
			light_bulb_set_brightness(0U);
		}
	}
}

/**@brief Function for initializing all clusters attributes.
 */
static void bulb_clusters_attr_init(void)
{
	/* Basic cluster attributes data */
	dev_ctx.basic_attr.zcl_version = ZB_ZCL_VERSION;
	dev_ctx.basic_attr.app_version = BULB_INIT_BASIC_APP_VERSION;
	dev_ctx.basic_attr.stack_version = BULB_INIT_BASIC_STACK_VERSION;
	dev_ctx.basic_attr.hw_version = BULB_INIT_BASIC_HW_VERSION;

	/* Use ZB_ZCL_SET_STRING_VAL to set strings, because the first byte
	 * should contain string length without trailing zero.
	 *
	 * For example "test" string will be encoded as:
	 *   [(0x4), 't', 'e', 's', 't']
	 */
	ZB_ZCL_SET_STRING_VAL(
		dev_ctx.basic_attr.mf_name,
		BULB_INIT_BASIC_MANUF_NAME,
		ZB_ZCL_STRING_CONST_SIZE(BULB_INIT_BASIC_MANUF_NAME));

	ZB_ZCL_SET_STRING_VAL(
		dev_ctx.basic_attr.model_id,
		BULB_INIT_BASIC_MODEL_ID,
		ZB_ZCL_STRING_CONST_SIZE(BULB_INIT_BASIC_MODEL_ID));

	ZB_ZCL_SET_STRING_VAL(
		dev_ctx.basic_attr.date_code,
		BULB_INIT_BASIC_DATE_CODE,
		ZB_ZCL_STRING_CONST_SIZE(BULB_INIT_BASIC_DATE_CODE));

	dev_ctx.basic_attr.power_source = BULB_INIT_BASIC_POWER_SOURCE;

	ZB_ZCL_SET_STRING_VAL(
		dev_ctx.basic_attr.location_id,
		BULB_INIT_BASIC_LOCATION_DESC,
		ZB_ZCL_STRING_CONST_SIZE(BULB_INIT_BASIC_LOCATION_DESC));

	dev_ctx.basic_attr.ph_env = BULB_INIT_BASIC_PH_ENV;

	/* Identify cluster attributes data. */
	dev_ctx.identify_attr.identify_time =
		ZB_ZCL_IDENTIFY_IDENTIFY_TIME_DEFAULT_VALUE;

	/* On/Off cluster attributes data. */
	dev_ctx.on_off_attr.on_off = (zb_bool_t)ZB_ZCL_ON_OFF_IS_ON;

	dev_ctx.level_control_attr.current_level =
		ZB_ZCL_LEVEL_CONTROL_LEVEL_MAX_VALUE;
	dev_ctx.level_control_attr.remaining_time =
		ZB_ZCL_LEVEL_CONTROL_REMAINING_TIME_DEFAULT_VALUE;

	ZB_ZCL_SET_ATTRIBUTE(
		DIMMABLE_LIGHT_ENDPOINT,
		ZB_ZCL_CLUSTER_ID_ON_OFF,
		ZB_ZCL_CLUSTER_SERVER_ROLE,
		ZB_ZCL_ATTR_ON_OFF_ON_OFF_ID,
		(zb_uint8_t *)&dev_ctx.on_off_attr.on_off,
		ZB_FALSE);

	ZB_ZCL_SET_ATTRIBUTE(
		DIMMABLE_LIGHT_ENDPOINT,
		ZB_ZCL_CLUSTER_ID_LEVEL_CONTROL,
		ZB_ZCL_CLUSTER_SERVER_ROLE,
		ZB_ZCL_ATTR_LEVEL_CONTROL_CURRENT_LEVEL_ID,
		(zb_uint8_t *)&dev_ctx.level_control_attr.current_level,
		ZB_FALSE);
}

/**@brief Callback function for handling ZCL commands.
 *
 * @param[in]   bufid   Reference to Zigbee stack buffer
 *                      used to pass received data.
 */
static void zcl_device_cb(zb_bufid_t bufid)
{
	zb_uint8_t cluster_id;
	zb_uint8_t attr_id;
	zb_zcl_device_callback_param_t  *device_cb_param =
		ZB_BUF_GET_PARAM(bufid, zb_zcl_device_callback_param_t);

	LOG_INF("%s id %hd", __func__, device_cb_param->device_cb_id);

	/* Set default response value. */
	device_cb_param->status = RET_OK;

	switch (device_cb_param->device_cb_id) {
	case ZB_ZCL_LEVEL_CONTROL_SET_VALUE_CB_ID:
		LOG_INF("Level control setting to %d",
			device_cb_param->cb_param.level_control_set_value_param
			.new_value);
		level_control_set_value(
			device_cb_param->cb_param.level_control_set_value_param
			.new_value);
		break;

	case ZB_ZCL_SET_ATTR_VALUE_CB_ID:
		cluster_id = device_cb_param->cb_param.
			     set_attr_value_param.cluster_id;
		attr_id = device_cb_param->cb_param.
			  set_attr_value_param.attr_id;

		if (cluster_id == ZB_ZCL_CLUSTER_ID_ON_OFF) {
			uint8_t value =
				device_cb_param->cb_param.set_attr_value_param
				.values.data8;

			LOG_INF("on/off attribute setting to %hd", value);
			if (attr_id == ZB_ZCL_ATTR_ON_OFF_ON_OFF_ID) {
				on_off_set_value((zb_bool_t)value);
			}
		} else if (cluster_id == ZB_ZCL_CLUSTER_ID_LEVEL_CONTROL) {
			uint16_t value = device_cb_param->cb_param.
					 set_attr_value_param.values.data16;

			LOG_INF("level control attribute setting to %hd",
				value);
			if (attr_id ==
			    ZB_ZCL_ATTR_LEVEL_CONTROL_CURRENT_LEVEL_ID) {
				level_control_set_value(value);
			}
		} else {
			/* Other clusters can be processed here */
			LOG_INF("Unhandled cluster attribute id: %d",
				cluster_id);
			device_cb_param->status = RET_NOT_IMPLEMENTED;
		}
		break;

	default:
		if (zcl_scenes_cb(bufid) == ZB_FALSE) {
			device_cb_param->status = RET_NOT_IMPLEMENTED;
		}
		break;
	}

	LOG_INF("%s status: %hd", __func__, device_cb_param->status);
}

/**@brief Zigbee stack event handler.
 *
 * @param[in]   bufid   Reference to the Zigbee stack buffer
 *                      used to pass signal.
 */
void zboss_signal_handler(zb_bufid_t bufid)
{
	/* Update network status LED. */
	zigbee_led_status_update(bufid, ZIGBEE_NETWORK_STATE_LED);

	/* No application-specific behavior is required.
	 * Call default signal handler.
	 */
	ZB_ERROR_CHECK(zigbee_default_signal_handler(bufid));

	/* All callbacks should either reuse or free passed buffers.
	 * If bufid == 0, the buffer is invalid (not passed).
	 */
	if (bufid) {
		zb_buf_free(bufid);
	}
}

int main(void)
{
	int blink_status = 0;
	int err;

	LOG_INF("Starting ZBOSS Light Bulb example");

	/* Initialize */
	configure_gpio();
	err = settings_subsys_init();
	if (err) {
		LOG_ERR("settings initialization failed");
	}
	register_factory_reset_button(FACTORY_RESET_BUTTON);

	// Register callback for handling ZCL commands.
    ZB_ZCL_REGISTER_DEVICE_CB(zcl_device_cb);

    // Register dimmer switch device context (endpoints).
    ZB_AF_REGISTER_DEVICE_CTX(&dimmable_light_ctx);

    // Register RSSI report device context (endpoint).
    ZB_AF_REGISTER_DEVICE_CTX(&rssi_report_ctx);

	bulb_clusters_attr_init();
	level_control_set_value(dev_ctx.level_control_attr.current_level);

	// Initialize ZCL scene table
	ZB_AF_SET_IDENTIFY_NOTIFICATION_HANDLER(DIMMABLE_LIGHT_ENDPOINT, identify_cb);

	/// Initialize ZCL scene table
	zcl_scenes_init();

	// Settings should be loaded after zcl_scenes_init
	err = settings_load();
	if (err) {
		LOG_ERR("settings loading failed");
	}

	/* Start Zigbee default thread */
	zigbee_enable();

	LOG_INF("ZBOSS Light Bulb example started");
	struct net_if *iface = net_if_get_default();
    start_energy_detection(iface);

	while (1) {
		dk_set_led(RUN_STATUS_LED, (++blink_status) % 2);
		k_sleep(K_MSEC(RUN_LED_BLINK_INTERVAL));
	}
}
```

## include/zb_custom_cluster.h
```c
// #ifndef ZB_CUSTOM_CLUSTER_H
// #define ZB_CUSTOM_CLUSTER_H

// #include <zboss_api.h>
// #include <zboss_api_zcl.h>
// #include <zboss_api_af.h>

// #define ZB_ZCL_CLUSTER_ID_RSSI_REPORT 0xFC00
// #define ZB_ZCL_ATTR_RSSI_ID 0x0000
// #define RSSI_REPORT_ENDPOINT 10


// // Ensure the attributes are constants
// #define ZB_ZCL_DECLARE_RSSI_REPORT_ATTRIB_LIST(attr_list, rssi) \
//     ZB_ZCL_START_DECLARE_ATTRIB_LIST(attr_list) \
//     ZB_ZCL_SET_ATTR_DESC(ZB_ZCL_ATTR_RSSI_ID, rssi) \
//     ZB_ZCL_FINISH_DECLARE_ATTRIB_LIST

// #define ZB_ZCL_DECLARE_RSSI_REPORT_CLUSTER_LIST(cluster_list, attr_list) \
//     ZB_ZCL_START_DECLARE_CLUSTER_LIST(cluster_list) \
//     ZB_ZCL_CLUSTER_DESC(ZB_ZCL_CLUSTER_ID_RSSI_REPORT, ZB_ZCL_ARRAY_SIZE(attr_list, zb_zcl_attr_t), attr_list, ZB_ZCL_CLUSTER_SERVER_ROLE, ZB_ZCL_MANUF_CODE_INVALID) \
//     ZB_ZCL_FINISH_DECLARE_CLUSTER_LIST

// #define ZB_DECLARE_RSSI_REPORT_EP(ep_name, ep_id, cluster_list) \
//     ZB_AF_SIMPLE_DESC_TYPE(ep_name, ep_id, ZB_AF_HA_PROFILE_ID, ZB_HA_DIMMABLE_LIGHT_DEVICE_ID, \
//         ZB_ZCL_ARRAY_SIZE(cluster_list, zb_zcl_cluster_desc_t), 0) \
//     ZB_AF_SIMPLE_DESC(ep_name, ep_id, ZB_AF_HA_PROFILE_ID, ZB_HA_DIMMABLE_LIGHT_DEVICE_ID, \
//         ZB_ZCL_ARRAY_SIZE(cluster_list, zb_zcl_cluster_desc_t), 0, cluster_list) \
//     ZB_AF_DECLARE_ENDPOINT_DESC(ep_name, ep_id, ZB_AF_HA_PROFILE_ID, 0, NULL, \
//         ZB_ZCL_ARRAY_SIZE(cluster_list, zb_zcl_cluster_desc_t), cluster_list, \
//         (zb_af_simple_desc_1_1_t*)&simple_desc_##ep_name, 0, NULL, 0, NULL)

// #define NET_REQUEST_IEEE802154_ED_SCAN \
//     (NET_MGMT_LAYER_L2 | NET_MGMT_LAYER_CODE(0x123) | NET_MGMT_COMMAND(0x01))

// #endif // ZB_CUSTOM_CLUSTER_H






// #ifndef ZB_CUSTOM_CLUSTER_H
// #define ZB_CUSTOM_CLUSTER_H

// #include <zboss_api.h>
// #include <zboss_api_zcl.h>
// #include <zboss_api_af.h>

// #define ZB_ZCL_CLUSTER_ID_RSSI_REPORT 0xFC00
// #define ZB_ZCL_ATTR_RSSI_ID 0x0000
// #define RSSI_REPORT_ENDPOINT 10

// /* RSSI Report Endpoint */
// #define RSSI_REPORT_EP_ID               10

// /* RSSI Attribute List */
// typedef struct {
//     zb_int8_t rssi_value;
// } rssi_report_attrs_t;

// static rssi_report_attrs_t rssi_report_attrs = {
//     .rssi_value = 0
// };


// ZB_ZCL_DECLARE_RSSI_REPORT_ATTRIB_LIST(
//     rssi_report_attr_list,
//     &rssi_report_attrs.rssi_value
// );


// ZB_ZCL_DECLARE_RSSI_REPORT_CLUSTER_LIST(
//     rssi_report_cluster_list,
//     rssi_report_attr_list
// );


// ZB_DECLARE_RSSI_REPORT_EP(
//     rssi_report_ep,
//     RSSI_REPORT_ENDPOINT,
//     rssi_report_cluster_list
// );

// /* Declare the device context for the custom cluster */
// ZBOSS_DECLARE_DEVICE_CTX_1_EP(
//     rssi_report_ctx,
//     rssi_report_ep
// );

// #endif // ZB_CUSTOM_CLUSTER_H
```
